## meta-bsp/conf/layer.conf
```bitbake
BBPATH .= ":${LAYERDIR}"
BBFILES += "${LAYERDIR}/recipes-*/*/*.bb \
        	  ${LAYERDIR}/recipes-*/*/*.bbappend"

BBFILE_COLLECTIONS += "automotive-samsung-e8"
BBFILE_PATTERN_automotive-samsung-e8 = "^${LAYERDIR}/"
###BBFILE_PRIORITY_automotive-samsung-e8 = "6"

##jspark added (6 lines)
SIGGEN_EXCLUDE_SAFE_RECIPE_DEPS += " \
  virtual/libc->linux-libc-headers-e8 \
  virtual/${TARGET_SYS}-gcc-initial->linux-libc-headers-e8 \
  virtual/${TARGET_PREFIX}libc-initial->linux-libc-headers-e8 \
  gcc-cross-${TARGET_ARCH}->linux-libc-headers-e8 \
  "

##jspark : this cimmand will be added later
##LAYERDEPENDS_automotive-samsung-e8 = "core android-layer"
```

## meta-bsp/conf/machine/automotive-samsung-e8.conf
```bitbake
#@TYPE: Machine
#@NAME: automotive-samsung-e8

#@DESCRIPTION: Machine configuration for automotive-samsung-e8 systems


#MACHINE_EXTRA_RRECOMMENDS += ""
MACHINE_EXTRA_RRECOMMENDS += " kernel-modules"
##EXTRA_IMAGEDEPENDS += "u-boot-at3"

require conf/machine/include/arm/arch-armv8.inc

IMAGE_FSTYPES += "tar.gz ext4"
PREFERRED_PROVIDER_virtual/kernel ?= "linux-samsung-e8"

KERNEL_CLASSES += "kernel-uimage kernel-uboot"
KERNEL_IMAGETYPE = "Image"

SERIAL_CONSOLE = "115200 ttySAC2"
KERNEL_EXTRA_ARGS += "LOADADDR=${UBOOT_ENTRYPOINT}"

UBOOT_ENTRYPOINT = "0x80008000"
UBOOT_LOADADDRESS = "0x80008000"

MACHINE_FEATURES = "alsa screen serial touchscreen usbhost ext2 usbgadget ethernet" 

PREFERRED_PROVIDER_linux-libc-headers = "linux-libc-headers-e8"

GCCVERSION = "4.9%"
```

## meta-bsp/recipes-kernel/linux/linux-samsung-e8/defconfig
```kconfig
# CONFIG_SWAP is not set
CONFIG_SYSVIPC=y
CONFIG_FHANDLE=y
CONFIG_NO_HZ=y
CONFIG_HIGH_RES_TIMERS=y
CONFIG_TASKS_RCU=y
CONFIG_RCU_NOCB_CPU=y
CONFIG_IKCONFIG=y
CONFIG_IKCONFIG_PROC=y
CONFIG_CGROUPS=y
CONFIG_CGROUP_FREEZER=y
CONFIG_CGROUP_CPUACCT=y
CONFIG_RESOURCE_COUNTERS=y
CONFIG_CGROUP_SCHED=y
CONFIG_RT_GROUP_SCHED=y
CONFIG_NAMESPACES=y
CONFIG_CC_OPTIMIZE_FOR_SIZE=y
# CONFIG_KALLSYMS is not set
CONFIG_EMBEDDED=y
# CONFIG_SLUB_DEBUG is not set
# CONFIG_COMPAT_BRK is not set
CONFIG_MODULES=y
CONFIG_MODULE_UNLOAD=y
CONFIG_MODULE_FORCE_UNLOAD=y
# CONFIG_BLK_DEV_BSG is not set
CONFIG_PARTITION_ADVANCED=y
# CONFIG_IOSCHED_DEADLINE is not set
CONFIG_SOC_EXYNOS8890=y
CONFIG_SOC_EXYNOS8890_EVT1=y
CONFIG_ARCH_EXYNOS8=y
CONFIG_PCI=y
CONFIG_PCI_MSI=y
CONFIG_PCI_EXYNOS=y
CONFIG_SMP=y
CONFIG_SCHED_MC=y
CONFIG_DISABLE_CPU_SCHED_DOMAIN_BALANCE=y
CONFIG_SCHED_HMP=y
CONFIG_HMP_FAST_CPU_MASK="4-7"
CONFIG_HMP_SLOW_CPU_MASK="0-3"
CONFIG_HMP_VARIABLE_SCALE=y
CONFIG_NR_CPUS=8
CONFIG_PREEMPT=y
CONFIG_KSM=y
CONFIG_CMA_PINPAGE_MIGRATION=y
CONFIG_ARMV8_DEPRECATED=y
CONFIG_SWP_EMULATION=y
CONFIG_CP15_BARRIER_EMULATION=y
CONFIG_SETEND_EMULATION=y
# CONFIG_EFI is not set
# CONFIG_CORE_DUMP_DEFAULT_ELF_HEADERS is not set
CONFIG_COMPAT=y
CONFIG_PM_AUTOSLEEP=y
CONFIG_PM_WAKELOCKS=y
CONFIG_PM_WAKELOCKS_LIMIT=0
# CONFIG_PM_WAKELOCKS_GC is not set
CONFIG_PM_RUNTIME=y
CONFIG_PM_DEBUG=y
CONFIG_SUSPEND_TIME=y
CONFIG_CPU_IDLE=y
CONFIG_ARM64_EXYNOS_CPUIDLE=y
CONFIG_CPU_FREQ=y
# CONFIG_CPU_FREQ_STAT is not set
CONFIG_CPU_FREQ_DEFAULT_GOV_INTERACTIVE=y
CONFIG_CPU_FREQ_GOV_PERFORMANCE=y
CONFIG_CPU_FREQ_GOV_USERSPACE=y
CONFIG_CPUFREQ_DT=y
CONFIG_ARM_EXYNOS_MP_CPUFREQ=y
CONFIG_EXYNOS_BIG_FREQ_BOOST=y
CONFIG_NET=y
CONFIG_UNIX=y
CONFIG_INET=y
# CONFIG_INET_XFRM_MODE_TRANSPORT is not set
# CONFIG_INET_XFRM_MODE_TUNNEL is not set
# CONFIG_INET_XFRM_MODE_BEET is not set
# CONFIG_INET_LRO is not set
# CONFIG_INET_DIAG is not set
# CONFIG_IPV6 is not set
# CONFIG_ANDROID_PARANOID_NETWORK is not set
# CONFIG_NET_ACTIVITY_STATS is not set
CONFIG_NET_SCHED=y
CONFIG_NET_SCH_HTB=y
CONFIG_NET_SCH_INGRESS=y
CONFIG_NET_CLS_U32=y
CONFIG_NET_EMATCH=y
CONFIG_NET_EMATCH_U32=y
CONFIG_NET_CLS_ACT=y
CONFIG_NET_ACT_POLICE=y
CONFIG_NET_ACT_GACT=y
CONFIG_NET_ACT_MIRRED=y
CONFIG_UEVENT_HELPER_PATH="dummy"
CONFIG_DEVTMPFS=y
CONFIG_DEVTMPFS_MOUNT=y
# CONFIG_FIRMWARE_IN_KERNEL is not set
CONFIG_FW_LOADER_USER_HELPER_FALLBACK=y
CONFIG_CMA_SIZE_MBYTES=24
CONFIG_BLK_DEV_LOOP=y
CONFIG_MCU_IPC=y
CONFIG_SCSI=m
CONFIG_BLK_DEV_SD=m
CONFIG_SCSI_SKIP_CACHE_OP=y
CONFIG_INPUT_MATRIXKMAP=m
CONFIG_INPUT_MOUSEDEV=m
CONFIG_INPUT_EVDEV=y
CONFIG_INPUT_KEYCOMBO=y
CONFIG_KEYBOARD_ATKBD=m
# CONFIG_INPUT_MOUSE is not set
CONFIG_INPUT_TOUCHSCREEN=y
CONFIG_TOUCHSCREEN_FTS=m
# CONFIG_SERIO_SERPORT is not set
CONFIG_SERIO_LIBPS2=y
CONFIG_VT_HW_CONSOLE_BINDING=y
CONFIG_DEVPTS_MULTIPLE_INSTANCES=y
CONFIG_LEGACY_PTY_COUNT=8
CONFIG_SERIAL_SAMSUNG=y
CONFIG_SERIAL_SAMSUNG_CONSOLE=y
CONFIG_HW_RANDOM=y
# CONFIG_HW_RANDOM_EXYNOS is not set
CONFIG_EXYRNG_FIPS_COMPLIANCE=y
CONFIG_EXYRNG_FAIL_POLICY_RESET=y
CONFIG_EXYRNG_USE_CRYPTOMANAGER=y
CONFIG_SPI=y
CONFIG_PINCTRL_EXYNOS=y
CONFIG_GPIOLIB=y
CONFIG_GPIO_SYSFS=y
CONFIG_GPIO_ARIZONA=y
# CONFIG_HWMON is not set
CONFIG_THERMAL=y
CONFIG_CPU_THERMAL=y
CONFIG_GPU_THERMAL=y
CONFIG_ISP_THERMAL=y
CONFIG_THERMAL_EMULATION=y
CONFIG_EXYNOS_THERMAL=y
CONFIG_EXYNOS_SWTRIP=y
CONFIG_CPU_THERMAL_IPA=y
CONFIG_CPU_THERMAL_IPA_CONTROL=y
CONFIG_EXYNOS_THERMAL_CORE=y
CONFIG_WATCHDOG=y
CONFIG_S3C2410_WATCHDOG=y
CONFIG_MFD_SEC_CORE=y
CONFIG_MFD_S2MPB02=y
CONFIG_MFD_SYSCON=y
CONFIG_MFD_ARIZONA_SPI=y
CONFIG_REGULATOR_FIXED_VOLTAGE=y
CONFIG_REGULATOR_S2MPS16=y
CONFIG_REGULATOR_S2MPB02=m
CONFIG_MEDIA_SUPPORT=y
CONFIG_MEDIA_CAMERA_SUPPORT=y
CONFIG_V4L_PLATFORM_DRIVERS=y
CONFIG_VIDEO_EXYNOS_SCALER=y
CONFIG_VIDEO_EXYNOS_MFC=y
CONFIG_VIDEO_EXYNOS_FIMG2D_V5=y
CONFIG_VIDEO_EXYNOS_FIMG2D_1SHOT2=y
CONFIG_VIDEO_EXYNOS_SMFC=y
CONFIG_MALI_T8XX=y
CONFIG_MALI_DVFS=y
CONFIG_MALI_MIDGARD_ENABLE_TRACE=y
CONFIG_MALI_EXPERT=y
CONFIG_MALI_PLATFORM_THIRDPARTY_NAME="8890"
# CONFIG_VGA_ARB is not set
CONFIG_DRM=y
# CONFIG_DRM_FBDEV_EMULATION is not set
CONFIG_DRM_EXYNOS_HQ=y
CONFIG_DRM_EXYNOS5433_DECON=y
CONFIG_DRM_EXYNOS_DSI=y
CONFIG_DRM_PANEL_S6E3HA2K=y
CONFIG_BACKLIGHT_LCD_SUPPORT=y
CONFIG_LCD_CLASS_DEVICE=y
CONFIG_BACKLIGHT_CLASS_DEVICE=y
# CONFIG_BACKLIGHT_GENERIC is not set
CONFIG_SOUND=y
CONFIG_SND=y
# CONFIG_SND_SUPPORT_OLD_API is not set
# CONFIG_SND_VERBOSE_PROCFS is not set
# CONFIG_SND_DRIVERS is not set
# CONFIG_SND_PCI is not set
# CONFIG_SND_SPI is not set
CONFIG_SND_SOC=y
CONFIG_SND_SOC_SAMSUNG=y
CONFIG_SND_SOC_I2S_TXSLOT_NUMBER=8
CONFIG_SND_SOC_I2S_RXSLOT_NUMBER=8
CONFIG_SND_SOC_SAMSUNG_AT3_8890_DUMMY=y
# CONFIG_HID is not set
# CONFIG_USB_SUPPORT is not set
CONFIG_MMC=y
CONFIG_MMC_CLKGATE=y
CONFIG_MMC_DW=y
CONFIG_MMC_DW_IDMAC=y
CONFIG_MMC_DW_64BIT_DESC=y
CONFIG_MMC_DW_EXYNOS=y
CONFIG_MMC_DW_FORCE_32BIT_SFR_RW=y
CONFIG_STAGING=y
CONFIG_ANDROID=y
# CONFIG_ANDROID_TIMED_OUTPUT is not set
CONFIG_SYNC=y
CONFIG_SW_SYNC=y
CONFIG_SW_SYNC_USER=y
CONFIG_ION=y
CONFIG_ION_EXYNOS=y
CONFIG_ION_EXYNOS_OF=y
# CONFIG_SEC_PM_DEBUG is not set
CONFIG_EXYNOS_CHIPID=y
CONFIG_EXYNOS_REBOOT=y
CONFIG_ECT=y
CONFIG_ECT_DUMP=y
CONFIG_EXYNOS_HOTPLUG_GOVERNOR=y
# CONFIG_PHY_EXYNOS_MIPI_VIDEO is not set
CONFIG_PHY_EXYNOS_MIPI=y
# CONFIG_PHY_EXYNOS_DP_VIDEO is not set
# CONFIG_EXYNOS_BUSMONITOR is not set
# CONFIG_EXYNOS_BTS is not set
# CONFIG_TRUSTONIC_TEE is not set
CONFIG_EXYNOS_APM=y
CONFIG_EXYNOS_CL_DVFS_CPU=y
CONFIG_EXYNOS_CL_DVFS_G3D=y
CONFIG_EXYNOS_CL_DVFS_MIF=y
CONFIG_EXT4_FS=y
CONFIG_EXT4_FS_SECURITY=y
CONFIG_TMPFS=y
CONFIG_TMPFS_POSIX_ACL=y
# CONFIG_NETWORK_FILESYSTEMS is not set
CONFIG_PRINTK_TIME=y
CONFIG_PRINTK_CORE_NUM=y
CONFIG_PRINTK_PROCESS=y
CONFIG_DEBUG_INFO=y
CONFIG_LOCKUP_DETECTOR=y
CONFIG_BOOTPARAM_HARDLOCKUP_PANIC=y
CONFIG_BOOTPARAM_SOFTLOCKUP_PANIC=y
CONFIG_PANIC_TIMEOUT=5
# CONFIG_CRYPTO_ANSI_CPRNG is not set
# CONFIG_CRYPTO_HW is not set
```

## meta-core/conf/distro/sel-automotive.conf
```bitbake
require conf/distro/poky.conf

DISTRO = "sel-automotive"
DISTRO_NAME = "Samsung Embedded Linux for Automotive"
DISTROOVERRIDES = "sel:${DISTRO}"

##require conf/distro/include/sel.conf

SANITY_TESTED_DISTROS = "\
    Ubuntu-15.04 \n\
"

INCOMPATIBLE_LICENSE += "LGPLv3 LGPLv3+"

DISTRO_FEATURES_DEFAULT_remove = " x11"
DISTRO_FEATURES_DEFAULT_remove = " irda"
DISTRO_FEATURES_DEFAULT_remove = " nfc"
DISTRO_FEATURES_append = " wayland opengles2 bluez5"
DISTRO_FEATURES_append = " systemd"

# Drop native language support. This removes the
# eglibc->bash->gettext->libc-posix-clang-wchar dependency.
USE_NLS = "no"

DEPLOY_DIR_BIN_ARCHIVES ?= "${DEPLOY_DIR}/bin-archives"
```

## meta-core/conf/layer.conf
```bitbake
BBPATH .= ":${LAYERDIR}"
BBFILES += "${LAYERDIR}/recipes-*/*/*.bb \
            ${LAYERDIR}/recipes-*/*/*.bbappend"

# Let us add layer-specific bbappends which are only applied when that
# layer is included in our configuration
BBFILES += "${@' '.join('${LAYERDIR}/%s/recipes*/*/*.bbappend' % layer \
               for layer in BBFILE_COLLECTIONS.split())}"
BBFILES += "${@' '.join('${LAYERDIR}/%s/recipes*/*/*.bb' % layer \
               for layer in BBFILE_COLLECTIONS.split())}"

BBFILE_COLLECTIONS += "samsung-automotive"
BBFILE_PRIORITY_samsung-automotive = "31"
BBFILE_PATTERN_samsung-automotive = "^${LAYERDIR}/"
##LAYERDEPENDS_samsung-automotive = "sel samsung-automotive-staging"

# Add license folder
LICENSE_PATH += "${LAYERDIR}/files/licenses"
# XSe license file
SAMSUNG_LICENSE_FILE = "${LAYERDIR}/files/licenses/Proprietary-Samsung"
SAMSUNG_LICENSE_FILE[vardepsexclude] += "LAYERDIR"

##BB_HASHBASE_WHITELIST_append = " BIN_ARCHIVE_MIRROR"
```
